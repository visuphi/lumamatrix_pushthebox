## CMakeLists.txt
```
# SPDX-License-Identifier: Apache-2.0

cmake_minimum_required(VERSION 3.20.0)

set(BOARD_ROOT "${CMAKE_CURRENT_SOURCE_DIR}")
find_package(Zephyr REQUIRED HINTS $ENV{ZEPHYR_BASE})
project(lumamatrix_pushthebox)

FILE(GLOB app_sources src/*.c)
target_sources(app PRIVATE ${app_sources})
target_include_directories(app PRIVATE src)
```

## Kconfig
```
# Copyright (c) 2019 Nordic Semiconductor ASA
# SPDX-License-Identifier: Apache-2.0

menu "WS2812 Sample Configuration"

config SAMPLE_LED_UPDATE_DELAY
	int "Delay between LED updates in ms"
	default 50
	help
	  Delay between LED updates in ms.

config SAMPLE_LED_BRIGHTNESS
	int "LED brightness"
	default 100
	range 1 255
	help
	  Brightness level of each LED. Defaults to a low value to make
	  it easier to distinguish colors.

endmenu

source "Kconfig.zephyr"
```

## prj.conf
```kconfig
CONFIG_LOG=y
CONFIG_LED_STRIP=y
CONFIG_LED_STRIP_LOG_LEVEL_DBG=y
CONFIG_WS2812_STRIP_RPI_PICO_PIO=y
```

## src/main.c
```c
/*
 * Copyright (c) 2026 Institute of Embedded Systems ZHAW
 *
 * SPDX-License-Identifier: Apache-2.0
 */
#include <zephyr/logging/log.h>
LOG_MODULE_REGISTER(main);

#include <zephyr/kernel.h>
#include <zephyr/drivers/gpio.h>
#include <zephyr/sys/util.h>

#include <map.h>
#include <buttons.h>


#define DELAY_TIME K_MSEC(CONFIG_SAMPLE_LED_UPDATE_DELAY)

#define RGB(_r, _g, _b) {.r = (_r), .g = (_g), .b = (_b)}




uint8_t map[8][8] = {{1, 1, 1, 1, 1, 0, 0, 0}, 
                    {1, 0, 2, 3, 1, 1, 1, 0},
                    {1, 0, 0, 3, 3, 0, 1, 0},
                    {1, 0, 0, 1, 1, 2, 1, 1},
                    {1, 1, 0, 0, 1, 0, 0, 1},
                    {0, 1, 2, 0, 0, 0, 0, 1},
                    {0, 1, 0, 0, 1, 1, 1, 1},
                    {0, 1, 1, 1, 1, 0, 0, 0}};

struct Position start = {.x = 2, .y = 2};

/* callbacks which are called when joystick is used */
void joystick_up_pressed(const struct device *dev, struct gpio_callback *cb, uint32_t pins)
{
	LOG_INF("joystick up callback");
	int rc;
	
	struct Position new_position = {.x = -1, .y = 0};
	rc = move_to(new_position);
	if (rc) {
		LOG_ERR("failed to move player");
	}
}

void joystick_down_pressed(const struct device *dev, struct gpio_callback *cb, uint32_t pins)
{
	LOG_INF("joystick down callback");
	int rc;

	struct Position new_position = {.x = 1, .y = 0};
	rc = move_to(new_position);
	if (rc) {
		LOG_ERR("failed to move player");
	}
}

void joystick_left_pressed(const struct device *dev, struct gpio_callback *cb, uint32_t pins)
{
	LOG_INF("joystick left callback");
	int rc;

	struct Position new_position = {.x = 0, .y = -1};
	rc = move_to(new_position);
	if (rc) {
		LOG_ERR("failed to move player");
	}
}

void joystick_right_pressed(const struct device *dev, struct gpio_callback *cb, uint32_t pins)
{
	LOG_INF("joystick right callback");
	int rc;

	struct Position new_position = {.x = 0, .y = 1};
	rc = move_to(new_position);
	if (rc) {
		LOG_ERR("failed to move player");
	}
}

void joystick_center_pressed(const struct device *dev, struct gpio_callback *cb, uint32_t pins)
{
	LOG_INF("joystick center callback");
	int rc;

	rc = load_map(map, start);
	if (rc) {
		LOG_ERR("failed to load map");
	}
}

/* HARDWARE INIT */
static int init_hw(void)
{
	int rc;

	rc = init_map();
	if (rc) {
		LOG_ERR("failed to init map");
	}

	rc = init_buttons(joystick_up_pressed, joystick_down_pressed, joystick_left_pressed,
			      joystick_right_pressed, joystick_center_pressed);
	if (rc) {
		LOG_ERR("failed to init buttons: %d", rc);
		return rc;
	}

	return 0;
}

int main(void)
{
	int rc;

	rc = init_hw();
	if (rc) {
		LOG_ERR("failed to init hw");
	}

	rc = load_map(map, start);
	if (rc) {
		LOG_ERR("failed to load map");
	}
	return 0;
}
```

## src/buttons.c
```c
#include <zephyr/kernel.h>
#include <zephyr/device.h>
#include <zephyr/drivers/gpio.h>
#include <zephyr/logging/log.h>

LOG_MODULE_REGISTER(buttons, LOG_LEVEL_INF);

static const struct gpio_dt_spec joystick_up = GPIO_DT_SPEC_GET(DT_ALIAS(sw0), gpios);
static const struct gpio_dt_spec joystick_down = GPIO_DT_SPEC_GET(DT_ALIAS(sw1), gpios);
static const struct gpio_dt_spec joystick_left = GPIO_DT_SPEC_GET(DT_ALIAS(sw2), gpios);
static const struct gpio_dt_spec joystick_right = GPIO_DT_SPEC_GET(DT_ALIAS(sw3), gpios);
static const struct gpio_dt_spec joystick_center = GPIO_DT_SPEC_GET(DT_ALIAS(sw4), gpios);

static struct gpio_callback joystick_up_cb_data;
static struct gpio_callback joystick_down_cb_data;
static struct gpio_callback joystick_left_cb_data;
static struct gpio_callback joystick_right_cb_data;
static struct gpio_callback joystick_center_cb_data;

static int setup_button(const struct gpio_dt_spec *btn, struct gpio_callback *cb,
			gpio_callback_handler_t handler, bool enable_irq)
{
	int rc;

	if (!gpio_is_ready_dt(btn)) {
		printk("Error: button device %s is not ready\n", btn->port->name);
		return -ENODEV;
	}

	rc = gpio_pin_configure_dt(btn, GPIO_INPUT);
	if (rc != 0) {
		printk("Error %d: failed to configure %s pin %d\n", rc, btn->port->name, btn->pin);
		return rc;
	}

	if (enable_irq) {
		rc = gpio_pin_interrupt_configure_dt(btn, GPIO_INT_EDGE_TO_ACTIVE);
		if (rc != 0) {
			printk("Error %d: failed to configure interrupt on %s pin %d\n", rc,
			       btn->port->name, btn->pin);
			return rc;
		}
	}

	gpio_init_callback(cb, handler, BIT(btn->pin));
	gpio_add_callback(btn->port, cb);

	return 0;
}

int init_buttons(gpio_callback_handler_t up_handler, gpio_callback_handler_t down_handler,
		 gpio_callback_handler_t left_handler, gpio_callback_handler_t right_handler,
		 gpio_callback_handler_t center_handler)
{
	int rc;

	rc = setup_button(&joystick_up, &joystick_up_cb_data, up_handler, true);
	if (rc) {
		return rc;
	}

	rc = setup_button(&joystick_down, &joystick_down_cb_data, down_handler, true);
	if (rc) {
		return rc;
	}

	rc = setup_button(&joystick_left, &joystick_left_cb_data, left_handler, true);
	if (rc) {
		return rc;
	}

	rc = setup_button(&joystick_right, &joystick_right_cb_data, right_handler, true);
	if (rc) {
		return rc;
	}

	rc = setup_button(&joystick_center, &joystick_center_cb_data, center_handler, true);
	if (rc) {
		return rc;
	}

	return 0;
}
```

## src/buttons.h
```c
#include <zephyr/drivers/gpio.h>

int init_buttons(gpio_callback_handler_t up_handler, gpio_callback_handler_t down_handler,
		 gpio_callback_handler_t left_handler, gpio_callback_handler_t right_handler,
		 gpio_callback_handler_t center_handler);
```

## src/map.c
```c
#include <map.h>
#include <zephyr/drivers/led_strip.h>

#include <zephyr/logging/log.h>
LOG_MODULE_REGISTER(map);

#define RGB(_r, _g, _b) {.r = (_r), .g = (_g), .b = (_b)}


static struct led_rgb pixels[STRIP_NUM_PIXELS];

uint8_t game_map[8][8];
uint8_t game_state[8][8];
struct Position player;

static const struct led_rgb colors[] = {
	RGB(CONFIG_SAMPLE_LED_BRIGHTNESS, 0x00, 0x00), /* red */
	RGB(0x00, CONFIG_SAMPLE_LED_BRIGHTNESS, 0x00), /* green */
	RGB(0x00, 0x00, CONFIG_SAMPLE_LED_BRIGHTNESS), /* blue */
};

static const struct led_rgb field_colors[] = {
	RGB(0, 0, 0),       /* empty */
	RGB(100, 100, 100), /* border */
	RGB(128, 0, 128),   /* BOX */
	RGB(0, 128, 128),   /* TARGET */
	RGB(0, 128, 0),     /* BOX_ON_TARGET */
};

struct led_rgb player_color = RGB(255, 0, 0);

int init_map(void) {
    return init_matrix();
}

int map_pos_to_index(int row, int col)
{
    return (7-row) * 8 + col;
}

int display_map(void)
{
	size_t map_len_y = sizeof(game_state[0]) / sizeof(game_state[0][0]);
	size_t map_len_x = sizeof(game_state) / sizeof(game_state[0]);
	int x, y;
	int index, element;
	for (y = 0; y < map_len_y; y++) {
		for (x = 0; x < map_len_x; x++) {
			index = map_pos_to_index(y, x);
			element = game_state[y][x];
			pixels[index] = field_colors[element];
		}
	}

	index = map_pos_to_index(player.x, player.y);
	pixels[index] = player_color;

    return display(pixels);
}

int display_win(void)
{
	size_t map_len_y = sizeof(game_state[0]) / sizeof(game_state[0][0]);
	size_t map_len_x = sizeof(game_state) / sizeof(game_state[0]);
	int x, y;
	int index;
	for (y = 0; y < map_len_y; y++) {
		for (x = 0; x < map_len_x; x++) {
			index = map_pos_to_index(y, x);
			pixels[index] = colors[1];
		}
	}

    return display(pixels);
}

int load_map(uint8_t new_map[8][8], struct Position start_pos)
{
	memcpy(game_state, new_map, sizeof(game_state));
	memcpy(game_map, new_map, sizeof(game_map));
	player = start_pos;
	
	return display_map();
}

bool check_success(void)
{
	size_t map_len_y = sizeof(game_state[0]) / sizeof(game_state[0][0]);
	size_t map_len_x = sizeof(game_state) / sizeof(game_state[0]);
	int x, y;
	for (y = 0; y < map_len_y; y++) {
		for (x = 0; x < map_len_x; x++) {
			if (game_state[y][x] == BOX) {
				return false;
			}
		}
	}
	return true;
}

int move_to(struct Position rel_pos)
{
	int new_x = player.x + rel_pos.x;
	int new_y = player.y + rel_pos.y;

	switch (game_state[new_x][new_y]) {
	case BORDER:
		break;
	case BOX_ON_TARGET:
		switch (game_state[new_x + rel_pos.x][new_y + rel_pos.y]) {
		case BORDER:        // intentional fallthrough
		case BOX_ON_TARGET: // intentional fallthrough
		case BOX:
			break;
		case NOTHING:
			game_state[new_x][new_y] = TARGET;
			game_state[new_x + rel_pos.x][new_y + rel_pos.y] = BOX;
			player.x = new_x;
			player.y = new_y;
			break;
		case TARGET:
			game_state[new_x][new_y] = TARGET;
			game_state[new_x + rel_pos.x][new_y + rel_pos.y] = BOX_ON_TARGET;
			player.x = new_x;
			player.y = new_y;
			break;
		}
		break;
	case BOX:
		switch (game_state[new_x + rel_pos.x][new_y + rel_pos.y]) {
		case BORDER:        // intentional fallthrough
		case BOX_ON_TARGET: // intentional fallthrough
		case BOX:
			break;
		case NOTHING:
			game_state[new_x][new_y] = NOTHING;
			game_state[new_x + rel_pos.x][new_y + rel_pos.y] = BOX;
			player.x = new_x;
			player.y = new_y;
			break;
		case TARGET:
			game_state[new_x][new_y] = NOTHING;
			game_state[new_x + rel_pos.x][new_y + rel_pos.y] = BOX_ON_TARGET;
			player.x = new_x;
			player.y = new_y;
			break;
		}
		break;
	case TARGET: // intentional fallthrough
	default:     // intentional fallthrough
	case NOTHING:
		player.x = new_x;
		player.y = new_y;
		break;
	}

	if (check_success()) {
		return display_win();
	} else {
		return display_map();
	}
}
```

## src/map.h
```c
#include <matrix.h>

#define NOTHING       0
#define BORDER        1
#define BOX           2
#define TARGET        3
#define BOX_ON_TARGET 4

struct Position {
    int x;
    int y;
} ;


struct map {
    int name;
    struct Position position;
    struct led_rgb color;
};

int init_map(void);
int load_map(uint8_t new_map[8][8], struct Position start_pos);
int move_to(struct Position rel_pos);
```

## src/matrix.c
```c
#include <matrix.h>
#include <zephyr/logging/log.h>
LOG_MODULE_REGISTER(matrix);

#define STRIP_NODE DT_ALIAS(led_strip)

static const struct device *const strip = DEVICE_DT_GET(STRIP_NODE);

int init_matrix (void) {
	if ( device_is_ready(strip) ) {
		LOG_INF("Found LED strip device %s", strip->name);
	} else {
		LOG_ERR("LED strip device %s is not ready", strip->name);
		return -1;
	}
	return 0;
}

int display (struct led_rgb * pixels) {
	int rc;
	rc = led_strip_update_rgb(strip, pixels, STRIP_NUM_PIXELS);
	if (rc) {
		LOG_ERR("couldn't update strip: %d", rc);
		return rc;
	}
    return 0;
}
```

## src/matrix.h
```c
#include <zephyr/drivers/led_strip.h>
#include <zephyr/device.h>

#if DT_NODE_HAS_PROP(DT_ALIAS(led_strip), chain_length)
#define STRIP_NUM_PIXELS DT_PROP(DT_ALIAS(led_strip), chain_length)
#else
#error Unable to determine length of LED strip
#endif

int init_matrix(void);
int display (struct led_rgb * pixels);
```
